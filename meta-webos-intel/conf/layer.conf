## meta-webos-intel/conf/layer.conf
```bitbake
# We have a conf and classes directory, add to BBPATH
BBPATH .= ":${LAYERDIR}"

# We have recipes-* directories, add to BBFILES
BBFILES += "${LAYERDIR}/recipes-*/*/*.bb \
            ${LAYERDIR}/recipes-*/*/*.bbappend"

BBFILE_COLLECTIONS += "meta-webos-intel"
BBFILE_PATTERN_meta-webos-intel = "^${LAYERDIR}/"
BBFILE_PRIORITY_meta-webos-intel = "56"

LAYERDEPENDS_meta-webos-intel = "core intel meta-acrn"
LAYERSERIES_COMPAT_meta-webos-intel = "kirkstone"
```

## meta-webos-intel/conf/machine/include/webos-intel.inc
```bitbake
# Add or override specific settings for this machine
PREFERRED_PROVIDER_virtual/kernel = "linux-intel-acrn-uos"
QEMU_EXTRAOPTIONS_qemux86_64 = "${QEMU_EXTRAOPTIONS_corei7-64}"
QEMU_EXTRAOPTIONS_intel_corei7_64 = "${QEMU_EXTRAOPTIONS_corei7-64}"
```

## meta-webos-intel/conf/machine/intel-corei7-64.conf
```bitbake
# Machine configuration for Intel Core i7 64-bit

# Inherit settings from the meta-intel layer's intel-corei7-64 machine configuration
require ../../meta-intel/conf/machine/intel-corei7-64.conf

require conf/machine/include/webos-intel.inc
```
